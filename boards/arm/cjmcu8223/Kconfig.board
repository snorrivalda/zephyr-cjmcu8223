## boards/arm/cjmcu8223/Kconfig.board
```kconfig
# Kconfig - nRF51 CJMCU8223 board configuration
#
# Copyright (c) 2018 Kiril Zyapkov
#
# SPDX-License-Identifier: Apache-2.0

config BOARD_CJMCU8223
	bool "CJMCU-8223"
	depends on SOC_NRF51822_QFAA
```

## boards/arm/cjmcu8223/Kconfig.defconfig
```kconfig
# Kconfig - nRF51 BBC_MICROBIT board configuration
#
# Copyright (c) 2016 Nordic Semiconductor ASA
#
# SPDX-License-Identifier: Apache-2.0

if BOARD_CJMCU8223

config BOARD
	default "cjmcu8223"

config BT_CTLR
	default BT

## if LIS3DH
##
## config LIS3DH_GPIO_PIN_NUM
## 	default 1
##
## config LIS3DH_I2C_ADDR
## 	default 0x19
##
## endif # LIS3DH

endif # BOARD_CJMCU8223
```

## boards/arm/cjmcu8223/cjmcu8223_defconfig
```kconfig
# SPDX-License-Identifier: Apache-2.0

CONFIG_SOC_SERIES_NRF51X=y
CONFIG_SOC_NRF51822_QFAA=y
CONFIG_BOARD_CJMCU8223=y

# clock control
#CONFIG_CLOCK_CONTROL_NRF5_K32SRC_XTAL=y
#CONFIG_CLOCK_CONTROL_NRF5_K32SRC_250PPM=y

# enable GPIO
CONFIG_GPIO=y

# enable uart driver
CONFIG_SERIAL=y

# enable console
CONFIG_CONSOLE=y
CONFIG_UART_CONSOLE=y

# enable on-board sensor
CONFIG_I2C=y
CONFIG_SENSOR=y
CONFIG_LIS2DH=y
```
